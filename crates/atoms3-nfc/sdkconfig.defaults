## crates/atoms3-nfc/sdkconfig.defaults
```kconfig
# alc-hub-atoms3-nfc (M5Stack AtomS3 Lite / ESP32-S3FN8)
#
# atoms3-print と同じ理由で PSRAM 無し (C124 = ESP32-S3FN8 は物理非搭載)。
# BLE/Ethernet/TLS を一切使わないミニマル構成 (NFC 検証専用)。

# ログ出力はネイティブ USB-C の USB Serial/JTAG コンソール経由
# (scripts/nfc_serial_beep.py が監視する対象)
CONFIG_ESP_CONSOLE_USB_SERIAL_JTAG=y

CONFIG_ESP_MAIN_TASK_STACK_SIZE=8192
CONFIG_FREERTOS_HZ=1000

# M5UnitUnified の vendor コード (pin.cpp 等) が旧 driver/i2c.h のシンボルを
# 参照しており、nfc_shim (新 driver/i2c_master.h) と同一バイナリにリンクされると
# ESP-IDF 起動直後の __attribute__((constructor)) チェックで即 abort する
# ("CONFLICT! driver_ng is not allowed to be used with this old driver",
#  components/driver/i2c/i2c.c の check_i2c_driver_conflict、実機で確認 2026-07-20)。
# 実際に i2c_driver_install() (旧 API) を呼ぶ経路は使っていない (nfc_shim.cpp は
# i2c_new_master_bus のみ使用) ため、ESP-IDF 公式の回避オプションでこのチェックを
# 無効化する。旧 API を実際に併用する変更をした場合はこの前提が崩れるので要再検討
CONFIG_I2C_SKIP_LEGACY_CONFLICT_CHECK=y

# 同じ理由で RMT も legacy (esp-idf-hal "rmt-legacy" feature, WS2812 LED 用) と
# 新ドライバの両方がリンクされて check_rmt_legacy_driver_conflict で abort する
# (実機で確認 2026-07-20)。新 RMT API は未使用のため無効化する
CONFIG_RMT_SKIP_LEGACY_CONFLICT_CHECK=y

# 2026-07-20, issue #96: 公式サンプル共通設定 (M5Unit-NFC
# examples/UnitUnified/common/sdkconfig.defaults) より。ST25R3916 ドライバの
# detect() 内部ポーリングはタイトなビジーウェイトで、Arduino では loop() が
# 常に Core1 (APP_CPU) で走るのに対し、ESP-IDF native の既定タスク配置は
# 未指定 (実質 Core0 寄り) になりうる。Arduino と同じ Core1 に固定し、
# IDLE1 のウォッチドッグ監視を止める (ビジーウェイトが IDLE1 を飢餓させるのは
# Arduino下でも同じで無害、との公式コメント通り)
CONFIG_ESP_MAIN_TASK_AFFINITY_CPU1=y
CONFIG_ESP_TASK_WDT_CHECK_IDLE_TASK_CPU1=n
```

## crates/atoms3-print/sdkconfig.defaults
```kconfig
# alc-hub-atoms3-print (M5Stack AtomS3 C123 / ESP32-S3FN8 + Atomic PoE Base A091)
#
# CoreS3 (ルートの sdkconfig.defaults) との違い:
# - PSRAM 無し (C123 = ESP32-S3FN8 は物理非搭載。SPIRAM 系は一切書かない)
# - BLE 無し (印刷ブリッジは W5500 Ethernet + HTTPS/WSS のみ)
# - W5500 SPI Ethernet を有効化 (Atomic PoE Base、INT 未配線 = polling)

# ホストリンク (デバッグ/AUTH 注入) は AtomS3 ネイティブ USB-C の
# USB Serial/JTAG コンソール経由
CONFIG_ESP_CONSOLE_USB_SERIAL_JTAG=y

CONFIG_ESP_MAIN_TASK_STACK_SIZE=8192
CONFIG_PTHREAD_TASK_STACK_SIZE_DEFAULT=8192
CONFIG_FREERTOS_HZ=1000
# HEAP DUMP (タスク別スタック余裕の列挙 = uxTaskGetSystemState) に必要
CONFIG_FREERTOS_USE_TRACE_FACILITY=y

# OTA (ota.rs): 新 FW が起動完了前に死んだらブートローダが旧スロットへ戻す
CONFIG_BOOTLOADER_APP_ROLLBACK_ENABLE=y

# auth-worker への HTTPS / cf-alc-recorder への WSS (公開 CA バンドル検証)
CONFIG_MBEDTLS_CERTIFICATE_BUNDLE=y

# W5500 (Atomic PoE Base) — SPI Ethernet。INT ピンは基板上未配線のため
# esp-idf-svc 側は SpiEventSource::polling を使う (eth_w5500.rs)
CONFIG_ETH_USE_SPI_ETHERNET=y
CONFIG_ETH_SPI_ETHERNET_W5500=y
```

## sdkconfig.defaults
```kconfig
# alc-hub-cores3 (M5Stack CoreS3 / ESP32-S3)

# UI ループとフォント描画のため余裕を持たせる
CONFIG_ESP_MAIN_TASK_STACK_SIZE=16384
CONFIG_PTHREAD_TASK_STACK_SIZE_DEFAULT=8192

# ホストリンク (Android タブレット / Windows PC) は CoreS3 ネイティブ USB-C の
# USB Serial/JTAG コンソール経由 (host_link.rs 参照)
CONFIG_ESP_CONSOLE_USB_SERIAL_JTAG=y

CONFIG_FREERTOS_HZ=1000
# HEAP DUMP (タスク別スタック余裕の列挙 = uxTaskGetSystemState) に必要 (Refs #27)
CONFIG_FREERTOS_USE_TRACE_FACILITY=y

# OTA (ota.rs): 新 FW が起動完了 (mark_running_slot_valid) 前に死んだら
# ブートローダが旧スロットへ自動で戻す
CONFIG_BOOTLOADER_APP_ROLLBACK_ENABLE=y

# Wi-Fi (Improv で設定) と BLE の同時使用のため SW コエグジストを明示的に有効化
CONFIG_ESP_COEX_SW_COEXIST_ENABLE=y

# PSRAM (CoreS3 は 8MB Quad PSRAM 搭載、従来未使用)。Wi-Fi(WSS/TLS) + BLE + UI
# 同時稼働で定常空きヒープが ~41KB まで逼迫していたため、4KB 以上の malloc を
# PSRAM に自動振り分けし、内蔵 SRAM を DMA/無線スタック用に温存する (Refs #28)
# MODE は QUAD (実機 2026-07-13: OCT だと "octal_psram: PSRAM chip is not
# connected, or wrong PSRAM line mode" で初期化失敗 → IGNORE_NOTFOUND により
# 黙って PSRAM なし起動になっていた。EVT HEAP の free_psram=0 で発覚)
CONFIG_SPIRAM=y
CONFIG_SPIRAM_MODE_QUAD=y
CONFIG_SPIRAM_SPEED_80M=y
CONFIG_SPIRAM_USE_MALLOC=y
# 4KB 未満の割当 (頻繁アクセスの小物・ドライバ周り) は内蔵 SRAM に残す
# (2048 も実機で試したが削減効果は ±2KB で誤差 — 残る内部RAM 消費はタスク
# スタック / BT controller / Wi-Fi ドライバ本体で、この閾値では動かない)
CONFIG_SPIRAM_MALLOC_ALWAYSINTERNAL=4096
# DMA / 内蔵必須の割当が枯渇しないよう内蔵側に 64KB 予約
CONFIG_SPIRAM_MALLOC_RESERVE_INTERNAL=65536
# PSRAM 初期化失敗時も abort せず PSRAM なしで boot 継続 (fail-safe)
CONFIG_SPIRAM_IGNORE_NOTFOUND=y

# auth-worker への HTTPS (device pairing / JWT mint、auth_link.rs)。
# esp_crt_bundle_attach で公開 CA バンドルを使いサーバ証明書を検証する
CONFIG_MBEDTLS_CERTIFICATE_BUNDLE=y

# TLS (WSS + HTTPS) と BLE の同時使用でヒープが枯渇し BLE_INIT: Malloc failed
# になる (実機で確認) ため、mbedTLS のバッファを動的確保にして idle 時は解放し、
# 送信バッファを縮める (上りフレームは小さい。受信は Cloudflare のレコードサイズ
# に合わせ既定 16KB のまま)
CONFIG_MBEDTLS_DYNAMIC_BUFFER=y
CONFIG_MBEDTLS_DYNAMIC_FREE_PEER_CERT=y
CONFIG_MBEDTLS_SSL_OUT_CONTENT_LEN=4096
# mbedTLS の割当を PSRAM に寄せる: WS 常時接続 (#31) で TLS セッション ~30-40KB
# が内部RAM に常駐するようになったため。PSRAM (Quad 8MB、#31 で実機確認済み) へ
# 移して内部RAM を Wi-Fi/BLE/DMA 用に温存する (実測: 常時接続時 free_int ~56KB
# → この設定で TLS 常駐分が戻る想定。EVT HEAP / mem-hud で前後比較する)
CONFIG_MBEDTLS_EXTERNAL_MEM_ALLOC=y

# Wi-Fi バッファ削減 (既定 static rx 10 / dynamic rx·tx 32)。スループットより
# ヒープ優先 — 実測で定常空きヒープ 41KB しかなく TLS (WSS) が入らないため
CONFIG_ESP_WIFI_STATIC_RX_BUFFER_NUM=6
CONFIG_ESP_WIFI_DYNAMIC_RX_BUFFER_NUM=16
CONFIG_ESP_WIFI_DYNAMIC_TX_BUFFER_NUM=16
# Wi-Fi/LWIP のバッファを可能な範囲で PSRAM に置く (内部RAM 使用率 77%→60% 台
# を狙う削減の主レバー)
CONFIG_SPIRAM_TRY_ALLOCATE_WIFI_LWIP=y
# AMPDU 無効化: 集約バッファ ~20-30KB を返上。上りは測定データの小フレームのみ
# なのでスループット低下は実害なし。BLE との 2.4GHz 共存スケジューリングも単純化
CONFIG_ESP_WIFI_AMPDU_TX_ENABLED=n
CONFIG_ESP_WIFI_AMPDU_RX_ENABLED=n

# BLE central のみ (ble-medical-gateway firmware-rust の設定を踏襲)
CONFIG_BT_ENABLED=y
CONFIG_BT_NIMBLE_ENABLED=y
# NimBLE ホストのヒープを PSRAM に寄せる: BLE_INIT: Malloc failed (実機で確認)
# の根絶。controller は内部RAM のまま (EXTERNAL は host 側の割当のみ)。
# 医療機器 (NT-100B / NBP-1BLE) の読み取りタイミングへの影響は実機で検証する
CONFIG_BT_NIMBLE_MEM_ALLOC_MODE_EXTERNAL=y
CONFIG_BT_NIMBLE_ROLE_CENTRAL=y
# 同時接続は 1 台 (体温計/血圧計を順に読む)。ヒープ節約 (WS の TLS と共存)
CONFIG_BT_NIMBLE_MAX_CONNECTIONS=1
CONFIG_BT_NIMBLE_ROLE_PERIPHERAL=n
CONFIG_BT_NIMBLE_ROLE_BROADCASTER=n
CONFIG_BT_NIMBLE_ROLE_OBSERVER=n
# Task WDT: UI ループ (メインタスク) の wedge を検出して chip をリセットする
# (hub-ui が起動時に自タスクを esp_task_wdt_add で登録し、ループ毎に feed)。
# - PANIC=y にしないと timeout は警告のみでリセットされない (既定 n)。
# - 既定の idle タスク監視は無効化: Wi-Fi/BLE が一時的に core を専有しても
#   誤リセットせず、明示登録した UI タスクの wedge だけを見る。
# リセット後は crashlog が reset_reason=task_wdt を crash_log で送信する。
CONFIG_ESP_TASK_WDT_TIMEOUT_S=10
CONFIG_ESP_TASK_WDT_PANIC=y
CONFIG_ESP_TASK_WDT_CHECK_IDLE_TASK_CPU0=n
CONFIG_ESP_TASK_WDT_CHECK_IDLE_TASK_CPU1=n

# ボンディング: 血圧計 (NBP-1BLE) は暗号化リンクを要求するため、Just Works で
# ペアリングしボンド情報を NVS に永続化する (次回接続で再ペアリング不要)。
# 体温計は非暗号化で動くが、血圧計の Measurement indication は暗号化後に届く。
CONFIG_BT_NIMBLE_NVS_PERSIST=y
CONFIG_BT_NIMBLE_SM_SC=y
CONFIG_BT_NIMBLE_SM_LEGACY=y
CONFIG_BT_NIMBLE_MAX_BONDS=8

# notify コールバック (emit_measurement) が nimble_host タスク上で println!/format!/
# ロック/イベント追加を行うため、既定 4KB ではスタックオーバーフローする
# (実機で血圧受信直後にクラッシュを確認)。ホストタスクのスタックを拡張する。
CONFIG_BT_NIMBLE_HOST_TASK_STACK_SIZE=8192
```
